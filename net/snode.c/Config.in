## net/snode.c/Config.in
```kconfig
menu "Configuration"
	depends on PACKAGE_snode.c-utils || PACKAGE_snode.c-core

	config SNODEC_GROUP_ID
		depends on PACKAGE_snode.c-utils
		int
		prompt "Group id of group snodec"
		default "1023"
		help
				The group id for unix group 'snodec'. This group is used for config SNODEC_file management.

				https://github.com/VolkerChristian/snode.c
				Volker Christian <me@vchrist.at>

	choice
		depends on PACKAGE_snode.c-core
		prompt "I/O Multiplexer"
		default SNODEC_EPOLL
		help
				The I/O multiplexer SNode.C will use by default.
				Possible choices:
				  * epoll (default)
				  * poll
				  * select

				https://github.com/VolkerChristian/snode.c
				Volker Christian <me@vchrist.at>

		config SNODEC_EPOLL
			select PACKAGE_snode.c-core-mux-epoll
			bool "epoll"
			help
					If choosen SNode.C will use 'epoll' as default I/O multiplexer.
					(overrideable with LD_PRELOAD)

					https://github.com/VolkerChristian/snode.c
					Volker Christian <me@vchrist.at>

		config SNODEC_POLL
			select PACKAGE_snode.c-core-mux-poll
			bool "poll"
			help
					If choosen SNode.C will use 'poll' as default I/O multiplexer.
					(override with LD_PRELOAD)

					https://github.com/VolkerChristian/snode.c
					Volker Christian <me@vchrist.at>

		config SNODEC_SELECT
			select PACKAGE_snode.c-core-mux-select
			bool "select"
			help
					If choosen SNode.C will use 'select' as default I/O multiplexer.
					(override with LD_PRELOAD)

					https://github.com/VolkerChristian/snode.c
					Volker Christian <me@vchrist.at>
	endchoice

	menu "Socket connection defaults"
		depends on PACKAGE_snode.c-core-socket-stream

		config SNODEC_READ_BLOCKSIZE
			int
			prompt "Read block size in bytes"
			default 16384
			help
					Read block size in bytes.
					(default: 16384)

					https://github.com/VolkerChristian/snode.c
					Volker Christian <me@vchrist.at>

		config SNODEC_WRITE_BLOCKSIZE
			int
			prompt "Write block size in bytes"
			default 16384
			help
					Write block size in bytes.
					(default: 16384)

					https://github.com/VolkerChristian/snode.c
					Volker Christian <me@vchrist.at>

		config SNODEC_READ_TIMEOUT
			int
			prompt "Read inactivity timeout in seconds"
			default 60
			help
					Read inactivity timeout after which the connection is terminated.
					(default: 60, 0 = unlimited)

					https://github.com/VolkerChristian/snode.c
					Volker Christian <me@vchrist.at>

		config SNODEC_WRITE_TIMEOUT
			int
			prompt "Write inactivity timeout in seconds"
			default 60
			help
					Write inactivity timeout after which the connection is terminated.
					(default: 60, 0 = unlimited)

					https://github.com/VolkerChristian/snode.c
					Volker Christian <me@vchrist.at>

		config SNODEC_TERMINATE_TIMEOUT
			int
			prompt "Shutdown inactivity timeout in seconds"
			default 1
			help
					Shutdown inactivity timeout after which the connection is terminated.
					(default: 1)

					https://github.com/VolkerChristian/snode.c
					Volker Christian <me@vchrist.at>
	endmenu

	menu "Server behaviour"
		depends on PACKAGE_snode.c-core-socket-stream

		config SNODEC_BACKLOG
			int
			default 5
			prompt "Listen backlog"
			help
					Listen backlog count.
					(default: 5)

					https://github.com/VolkerChristian/snode.c
					Volker Christian <me@vchrist.at>

		config SNODEC_ACCEPTS_PER_TICK
			int
			prompt "Accepts per tick"
			default 1
			help
					Maximum number of accepts per tick.
					(default: 1)

					https://github.com/VolkerChristian/snode.c
					Volker Christian <me@vchrist.at>
	endmenu

	menu "Physical socket behaviour"
		depends on PACKAGE_snode.c-core-socket

		config SNODEC_ACCEPT_TIMEOUT
			int
			default 0
			prompt "Accept inactivity timeout in seconds"
			help
					Accept inactivity (no new connection attempts) after which a SocketServer
					terminated.
					(default: 0, 0 = unlimited)

					https://github.com/VolkerChristian/snode.c
					Volker Christian <me@vchrist.at>

		config SNODEC_CONNECT_TIMEOUT
			int
			default 10
			prompt "Connect timeout in seconds"
			help
					Timeout in seconds after which a SocketClient is terminated in case the
					connection could not be established.
					(default: 10, 0 = unlimited)

					https://github.com/VolkerChristian/snode.c
					Volker Christian <me@vchrist.at>

		menuconfig SNODEC_RECONNECT
			bool
			default n
			prompt "Reconnect after disconnect"
			help
					Reconnect to a server in case a previous connection has been terminated.
					(default: n)

					https://github.com/VolkerChristian/snode.c
					Volker Christian <me@vchrist.at>

		config SNODEC_RECONNECT_TIME
		    depends on SNODEC_RECONNECT
			string
			default 1
			prompt "Reconnect time in seconds"
			help
					Duration after disconnect bevore reconnecting.
					(default: 1)

					https://github.com/VolkerChristian/snode.c
					Volker Christian <me@vchrist.at>

		menuconfig SNODEC_RETRY
			bool
			default n
			prompt "Retry listen and connect"
			help
					Retry *listen* in case the socket address/port is already in use.
					Retry *connect* in case the connection to the peer could not be established.
					(default: n)

					https://github.com/VolkerChristian/snode.c
					Volker Christian <me@vchrist.at>

		config SNODEC_RETRY_TIMEOUT
		    depends on SNODEC_RETRY
			int
			default 1
			prompt "Retry interval in seconds"
			help
					The retry interval between two retries modified with jitter and exponential
					backoff.
					(default: 1)

					https://github.com/VolkerChristian/snode.c
					Volker Christian <me@vchrist.at>

		config SNODEC_RETRY_TRIES
		    depends on SNODEC_RETRY
			int
			default 0
			prompt "Upper limit of retry tries"
			help
					The upper limit of retrying to listen on an address and connect to a peer.
					(default: 0, 0 = unlimited)

					https://github.com/VolkerChristian/snode.c
					Volker Christian <me@vchrist.at>

		config SNODEC_RETRY_BASE
		    depends on SNODEC_RETRY
			string
			default "1.8"
			prompt "Base of exponential backoff"
			help
					The current retry timeout will be multiplied by this value for every retry
					attempt.
					(default: 1.8)

					https://github.com/VolkerChristian/snode.c
					Volker Christian <me@vchrist.at>

		config SNODEC_RETRY_JITTER
		    depends on SNODEC_RETRY
			int
			default 0
			prompt "Jitter of retry timeout in percent"
			help
					Maximum jitter in percent to apply randomly to calculated retry timeout.
					(default: 0, 0 = disable)

					https://github.com/VolkerChristian/snode.c
					Volker Christian <me@vchrist.at>

		config SNODEC_RETRY_LIMIT
		    depends on SNODEC_RETRY
			int
			default 0
			prompt "Upper limit of retry timeout"
			help
					The retry timeout will not exceed this limit
					(default: 0, 0 = unlimited).

					https://github.com/VolkerChristian/snode.c
					Volker Christian <me@vchrist.at>

		config SNODEC_REUSE_ADDRESS
			bool
			default n
			prompt "Reuse address"
			help
					Wether the socket address should be reusable immediately.
					(default: n)

					https://github.com/VolkerChristian/snode.c
					Volker Christian <me@vchrist.at>

		config SNODEC_REUSE_PORT
			depends on PACKAGE_snode.c-net-in || PACKAGE_snode.c-net-in6
			bool
			default n
			prompt "Reuse port (IPv4/IPv6)"
			help
					If set to 'y' the port could be reused in case of IPv4 or IPv6. On Linux this
					makes it possible to create a simple "multitasking" server.
					(default: n)

					https://github.com/VolkerChristian/snode.c
					Volker Christian <me@vchrist.at>

		config SNODEC_IPV6_ONLY
			depends on PACKAGE_snode.c-net-in6
			bool
			default n
			prompt "IPv6 only"
			help
					If selected an IPv6 server socket accepts only IPv6 connections (single stack).
					If not selected IPv4 connections are also accepted (dual stack).
					(default: n)

					https://github.com/VolkerChristian/snode.c
					Volker Christian <me@vchrist.at>

		config SNODEC_IPV4_MAPPED
			depends on PACKAGE_snode.c-net-in6
			bool
			default n
			prompt "IPv4-mapped IPv6 addresses"
			help
					If selected domain names will resolve to IPv4-mapped IPv6 addresses also if
					necessary.
					(default: n)

					https://github.com/VolkerChristian/snode.c
					Volker Christian <me@vchrist.at>
	endmenu

	menu "SSL/TLS defaults"
		depends on PACKAGE_snode.c-core-socket-stream-tls

		config SNODEC_TLS_INIT_TIMEOUT
			int
			prompt "SSL/TLS initial handshake timeout in seconds"
			default 10
			help
					Maximum duration of the SSL/TLS initial handshake befor the connection iterminated.
					(default: 10)

					https://github.com/VolkerChristian/snode.c
					Volker Christian <me@vchrist.at>

		config SNODEC_TLS_SHUTDOWN_TIMEOUT
			int
			prompt "SSL/TLS teardown timeout in seconds"
			default 2
			help
					Maximum duration of the SSL/TLS teardown befor the connection is terminated.
					(default: 2)

					https://github.com/VolkerChristian/snode.c
					Volker Christian <me@vchrist.at>
	endmenu
endmenu
```
